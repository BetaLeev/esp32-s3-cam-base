## sdkconfig.defaults
```kconfig
# SCCB/I2C 驱动配置 - 使用 legacy I2C 驱动 (与 Arduino 可工作代码一致)
# sccb-ng 在 ESP-IDF 6.0 上 I2C 超时严格，导致 OV3660 探测失败
CONFIG_SCCB_HARDWARE_I2C_DRIVER_LEGACY=y
CONFIG_SCCB_HARDWARE_I2C_PORT1=y
CONFIG_I2C_SUPPRESS_DEPRECATE_WARN=y
CONFIG_I2C_SKIP_LEGACY_CONFLICT_CHECK=y

# Brownout 检测禁用 (Arduino 代码 WRITE_PERI_REG(RTC_CNTL_BROWN_OUT_REG, 0) 等效)
CONFIG_ESP_BROWNOUT_DET=n
CONFIG_ESP_BROWNOUT_USE_INTR=n
CONFIG_ESP_SYSTEM_BROWNOUT_INTR=n

CONFIG_IDF_TARGET="esp32s3"
CONFIG_IDF_TARGET_ESP32S3=y
CONFIG_ESP32_CAMERA_ENABLED=y
CONFIG_SCCB_CLK_FREQ=100000

# ===== Flash 配置 =====
CONFIG_ESPTOOLPY_FLASHSIZE_8MB=y
CONFIG_ESPTOOLPY_FLASHSIZE="8MB"

# ===== 启用 PSRAM =====
CONFIG_SPIRAM=y
CONFIG_SPIRAM_MODE_OCT=y
CONFIG_SPIRAM_TYPE_AUTO=y
CONFIG_SPIRAM_ALLOW_ALLOCATE_CRITICAL_MEMORY=y
CONFIG_SPIRAM_ALLOW_STACK_EXTERNAL_MEMORY=y

# 解决摄像头 PSRAM 分配
CONFIG_CAMERA_CORE0=y
CONFIG_CAMERA_CORE1=n


# ===== LittleFS Configuration =====
CONFIG_LITTLEFS=y
CONFIG_LITTLEFS_MAX_PARTITIONS=3
CONFIG_LITTLEFS_PAGE_SIZE=256
CONFIG_LITTLEFS_OBJ_NAME_LEN=64
CONFIG_LITTLEFS_READ_SIZE=256
CONFIG_LITTLEFS_WRITE_SIZE=256
CONFIG_LITTLEFS_LOOKAHEAD_SIZE=128
CONFIG_LITTLEFS_CACHE_SIZE=512
CONFIG_LITTLEFS_BLOCK_CYCLES=512
CONFIG_LITTLEFS_USE_MTIME=y
CONFIG_LITTLEFS_MTIME_USE_SECONDS=y
CONFIG_LITTLEFS_PARTITION_LABEL="webfs"
```
